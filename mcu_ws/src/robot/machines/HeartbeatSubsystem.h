/**
 * @file HeartbeatSubsystem.h
 * @brief Publishes a heartbeat message at regular intervals.
 * @author Generated by Copilot
 * @date 12/16/2025
 */
#pragma once

#include <RTOSSubsystem.h>
#include <micro_ros_utilities/string_utilities.h>
#include "DebugLog.h"
#include <microros_manager_robot.h>
#include <rcl/rcl.h>
#include <rclc/rclc.h>
#include <std_msgs/msg/string.h>
#include <uxr/client/util/time.h>

#if defined(USE_FREERTOS)
#include "FreeRTOSCompat.h"
#endif

namespace Subsystem {

class HeartbeatSubsystemSetup : public Classes::BaseSetup {
 public:
  const char* topic_name;

  HeartbeatSubsystemSetup(const char* _id,
                          const char* _topic = "/mcu_robot/heartbeat")
      : Classes::BaseSetup(_id), topic_name(_topic) {}
};

class HeartbeatSubsystem : public IMicroRosParticipant,
                           public Subsystem::RTOSSubsystem {
 public:
  explicit HeartbeatSubsystem(const HeartbeatSubsystemSetup& setup)
      : Subsystem::RTOSSubsystem(setup), setup_(setup) {}

  bool init() override { return true; }
  void begin() override {}
  void update() override {
    if (!pub_.impl) return;
#if defined(USE_FREERTOS)
    Threads::Scope lock(data_mutex_);
    data_ready_ = true;
#else
    (void)rcl_publish(&pub_, &msg_, NULL);
#endif
  }
  void pause() override {}
  void reset() override { pause(); }
  const char* getInfo() override {
    static const char info[] = "HeartbeatSubsystem";
    return info;
  }

  bool onCreate(rcl_node_t* node, rclc_executor_t* executor) override {
    (void)executor;
    node_ = node;
    if (rclc_publisher_init_best_effort(
            &pub_, node, ROSIDL_GET_MSG_TYPE_SUPPORT(std_msgs, msg, String),
            setup_.topic_name) != RCL_RET_OK) {
      DEBUG_PRINTLN("[HB] onCreate FAIL: publisher init");
      return false;
    }
    msg_.data = micro_ros_string_utilities_set(msg_.data, "HEARTBEAT");
    DEBUG_PRINTLN("[HB] onCreate OK");
    return true;
  }

  void onDestroy() override {
    // destroy_entities() finalises the rcl_node before calling onDestroy, so
    // rcl_publisher_fini would see a dead node and fail while leaving pub_.impl
    // non-NULL — causing the update thread to publish on a stale handle.
    // The DDS resources are freed by rclc_support_fini; just reset local state.
    pub_ = rcl_get_zero_initialized_publisher();
    node_ = nullptr;
  }

 public:
  void publishAll() override {
#if defined(USE_FREERTOS)
    Threads::Scope lock(data_mutex_);
    if (!data_ready_ || !pub_.impl) return;
    (void)rcl_publish(&pub_, &msg_, NULL);
    data_ready_ = false;
#endif
  }

 private:
  const HeartbeatSubsystemSetup setup_;
  rcl_publisher_t pub_{};
  std_msgs__msg__String msg_{};
  rcl_node_t* node_ = nullptr;
  bool data_ready_ = false;
#if defined(USE_FREERTOS)
  Threads::Mutex data_mutex_;
#endif
};

}  // namespace Subsystem
